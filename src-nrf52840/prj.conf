## CMakeLists.txt
```
#
# Copyright (c) 2018 Nordic Semiconductor
#
# SPDX-License-Identifier: LicenseRef-Nordic-5-Clause
#
cmake_minimum_required(VERSION 3.20.0)

find_package(Zephyr REQUIRED HINTS $ENV{ZEPHYR_BASE})
project(app LANGUAGES CXX)

FILE(GLOB app_sources src/*.cpp src/*.c)
target_sources(app PRIVATE ${app_sources})


zephyr_library_include_directories(.)

target_link_libraries(app PUBLIC stdc++) 
```

## Kconfig
```
#
# Copyright (c) 2018 Nordic Semiconductor
#
# SPDX-License-Identifier: LicenseRef-Nordic-5-Clause
#

source "Kconfig.zephyr"

menu "nRF52840 BLE lamp service demo"

config BT_LBS_SECURITY_ENABLED
	bool "Enable security"
	default y
	select BT_SMP
	select BT_SETTINGS
	select FLASH
	select FLASH_PAGE_LAYOUT
	select FLASH_MAP
	select NVS
	select SETTINGS
	help
	  "Enable BLE security for the LED-Button service"

endmenu
```

## sample.yaml
```
sample:
  description: Bluetooth Low Energy Lamp service demo
  name: BLE Lamp service
tests:
  sample.bluetooth.peripheral_lbs:
    sysbuild: true
    build_only: true
    integration_platforms:
      - nrf52dk/nrf52832
      - nrf52840dk/nrf52840
      - nrf5340dk/nrf5340/cpuapp
      - nrf5340dk/nrf5340/cpuapp/ns
      - thingy53/nrf5340/cpuapp
      - thingy53/nrf5340/cpuapp/ns
      - nrf54l15pdk/nrf54l15/cpuapp
      - nrf54h20dk/nrf54h20/cpuapp
    platform_allow: nrf52dk/nrf52832 nrf52840dk/nrf52840
      nrf5340dk/nrf5340/cpuapp nrf5340dk/nrf5340/cpuapp/ns thingy53/nrf5340/cpuapp
      thingy53/nrf5340/cpuapp/ns nrf54l15pdk/nrf54l15/cpuapp nrf54h20dk/nrf54h20/cpuapp
    tags: bluetooth ci_build sysbuild
  sample.bluetooth.peripheral_lbs_minimal:
    sysbuild: true
    build_only: true
    extra_args: OVERLAY_CONFIG=prj_minimal.conf
    integration_platforms:
      - nrf52dk/nrf52810
      - nrf52840dk/nrf52811
      - nrf52833dk/nrf52820
    platform_allow: nrf52dk/nrf52810 nrf52840dk/nrf52811 nrf52833dk/nrf52820
    tags: bluetooth ci_build sysbuild
  sample.bluetooth.peripheral_lbs_no_security:
    sysbuild: true
    build_only: true
    extra_args: CONFIG_BT_LBS_SECURITY_ENABLED=n
    integration_platforms:
      - nrf52dk/nrf52832
      - nrf52840dk/nrf52840
      - nrf5340dk/nrf5340/cpuapp
      - nrf5340dk/nrf5340/cpuapp/ns
      - thingy53/nrf5340/cpuapp
      - thingy53/nrf5340/cpuapp/ns
      - nrf54l15pdk/nrf54l15/cpuapp
      - nrf54h20dk/nrf54h20/cpuapp
    platform_allow: nrf52dk/nrf52832 nrf52840dk/nrf52840
      nrf5340dk/nrf5340/cpuapp nrf5340dk/nrf5340/cpuapp/ns thingy53/nrf5340/cpuapp
      thingy53/nrf5340/cpuapp/ns nrf54l15pdk/nrf54l15/cpuapp nrf54h20dk/nrf54h20/cpuapp
    tags: bluetooth ci_build sysbuild
  sample.bluetooth.peripheral_lbs_bt_ota_dfu:
    sysbuild: true
    build_only: true
    integration_platforms:
      - nrf52dk/nrf52832
      - nrf52840dk/nrf52840
      - nrf5340dk/nrf5340/cpuapp
      - nrf5340dk/nrf5340/cpuapp/ns
    platform_allow: nrf52dk/nrf52832 nrf52840dk/nrf52840 nrf5340dk/nrf5340/cpuapp
      nrf5340dk/nrf5340/cpuapp/ns
    tags: bluetooth ci_build sysbuild
    extra_configs:
      - CONFIG_BOOTLOADER_MCUBOOT=y
      - CONFIG_NCS_SAMPLE_MCUMGR_BT_OTA_DFU=y
  sample.bluetooth.peripheral_lbs_bt_ota_dfu.direct_xip:
    sysbuild: true
    build_only: true
    integration_platforms:
      - nrf52840dk/nrf52840
    platform_allow: nrf52840dk/nrf52840
    tags: bluetooth ci_build sysbuild
    extra_args: mcuboot_CONFIG_BOOT_DIRECT_XIP=y
    extra_configs:
      - CONFIG_BOOTLOADER_MCUBOOT=y
      - CONFIG_NCS_SAMPLE_MCUMGR_BT_OTA_DFU=y
      - CONFIG_MCUBOOT_BOOTLOADER_MODE_DIRECT_XIP=y
  sample.bluetooth.peripheral_lbs_bt_ota_dfu.direct_xip.revert:
    sysbuild: true
    build_only: true
    integration_platforms:
      - nrf52840dk/nrf52840
    platform_allow: nrf52840dk/nrf52840
    tags: bluetooth ci_build sysbuild
    extra_args: mcuboot_CONFIG_BOOT_DIRECT_XIP=y mcuboot_CONFIG_BOOT_DIRECT_XIP_REVERT=y
    extra_configs:
      - CONFIG_BOOTLOADER_MCUBOOT=y
      - CONFIG_NCS_SAMPLE_MCUMGR_BT_OTA_DFU=y
      - CONFIG_MCUBOOT_BOOTLOADER_MODE_DIRECT_XIP_WITH_REVERT=y
```

## prj.conf
```kconfig
#
# Copyright (c) 2018 Nordic Semiconductor
#
# SPDX-License-Identifier: LicenseRef-Nordic-5-Clause
#
CONFIG_CPP=y
CONFIG_REQUIRES_FULL_LIBCPP=y
# CONFIG_NEWLIB_LIBC=y
# CONFIG_CPLUSPLUS=y	    # warning: Deprecated symbol CPLUSPLUS is enabled.
# CONFIG_LIB_CPLUSPLUS=y	# -warning: Deprecated symbol LIB_CPLUSPLUS is enabled.

CONFIG_NCS_SAMPLES_DEFAULTS=y
CONFIG_DK_LIBRARY=y

CONFIG_BT=y
CONFIG_BT_PERIPHERAL=y
CONFIG_BT_DEVICE_NAME="nrf52840-lamp"

CONFIG_SYSTEM_WORKQUEUE_STACK_SIZE=2048

# CONFIG_LOG=y
# CONFIG_LOG_DEFAULT_LEVEL=2
# CONFIG_LOG_DEFAULT_LEVEL=4


# Enable the LBS service
# CONFIG_BT_LBS=y
# CONFIG_BT_LBS_POLL_BUTTON=y
```

## prj_minimal.conf
```kconfig
# BEGIN Configurations from basic/minimal
CONFIG_CPP=y
CONFIG_CPLUSPLUS=y
CONFIG_LIB_CPLUSPLUS=y
CONFIG_NEWLIB_LIBC=y

CONFIG_NCS_SAMPLES_DEFAULTS=y

CONFIG_BT=y
CONFIG_BT_PERIPHERAL=y
CONFIG_BT_DEVICE_NAME="nrf52840-lamp"

# Enable the LBS service
CONFIG_BT_LBS=y
CONFIG_BT_LBS_POLL_BUTTON=y
CONFIG_DK_LIBRARY=y

# Drivers and peripherals
CONFIG_I2C=n
CONFIG_WATCHDOG=n
CONFIG_GPIO=n
CONFIG_SPI=n
CONFIG_SERIAL=n

# Power management

# Interrupts
CONFIG_DYNAMIC_INTERRUPTS=n
CONFIG_IRQ_OFFLOAD=n

# Memory protection
CONFIG_THREAD_STACK_INFO=n
CONFIG_THREAD_CUSTOM_DATA=n
CONFIG_FPU=n

# Boot
CONFIG_BOOT_BANNER=n
CONFIG_BOOT_DELAY=0

# Console
CONFIG_CONSOLE=n
CONFIG_UART_CONSOLE=n
CONFIG_STDOUT_CONSOLE=n
CONFIG_PRINTK=n
CONFIG_EARLY_CONSOLE=n

# Build
CONFIG_SIZE_OPTIMIZATIONS=y

# ARM
CONFIG_ARM_MPU=n
# END Configurations from basic/minimal

# In order to correctly tune the stack sizes for the threads the following
# Configurations can enabled to print the current use:
# CONFIG_THREAD_NAME=y
# CONFIG_THREAD_ANALYZER=y
# CONFIG_THREAD_ANALYZER_AUTO=y
# CONFIG_THREAD_ANALYZER_RUN_UNLOCKED=y
# CONFIG_THREAD_ANALYZER_USE_PRINTK=y
# CONFIG_CONSOLE=y
# CONFIG_UART_CONSOLE=y
# CONFIG_SERIAL=y
# CONFIG_PRINTK=y

# Example output of thread analyzer
# SDC RX              : unused 816 usage 208 / 1024 (20 %)
# BT RX               : unused 1784 usage 416 / 2200 (18 %)
# BT TX               : unused 992 usage 544 / 1536 (35 %)
# thread_analyzer     : unused 136 usage 376 / 512 (73 %)
# sysworkq            : unused 1824 usage 224 / 2048 (10 %)
# MPSL signal         : unused 520 usage 504 / 1024 (49 %)
# idle 00             : unused 192 usage 64 / 256 (25 %)
# main                : unused 136 usage 888 / 1024 (86 %)
# Configurations set based on thread analyzer output.
CONFIG_BT_RX_STACK_SIZE=1024
CONFIG_BT_HCI_TX_STACK_SIZE_WITH_PROMPT=y
CONFIG_BT_HCI_TX_STACK_SIZE=640
CONFIG_SYSTEM_WORKQUEUE_STACK_SIZE=1536
CONFIG_MPSL_WORK_STACK_SIZE=640
CONFIG_MAIN_STACK_SIZE=1024
CONFIG_IDLE_STACK_SIZE=128
CONFIG_ISR_STACK_SIZE=1024

# Disable features not needed
CONFIG_TIMESLICING=n
CONFIG_MINIMAL_LIBC_MALLOC=n
CONFIG_LOG=n
CONFIG_ASSERT=n

# Disable Bluetooth features not needed
CONFIG_BT_DEBUG_NONE=y
CONFIG_BT_ASSERT=n
CONFIG_BT_DATA_LEN_UPDATE=n
CONFIG_BT_PHY_UPDATE=n
CONFIG_BT_GATT_CACHING=n
CONFIG_BT_GATT_SERVICE_CHANGED=n
CONFIG_BT_GAP_PERIPHERAL_PREF_PARAMS=n
CONFIG_BT_SETTINGS_CCC_LAZY_LOADING=y
CONFIG_BT_HCI_VS=n

# Disable Bluetooth controller features not needed
CONFIG_BT_CTLR_PRIVACY=n
CONFIG_BT_CTLR_PHY_2M=n

# Reduce Bluetooth buffers
CONFIG_BT_BUF_EVT_DISCARDABLE_COUNT=1
CONFIG_BT_BUF_EVT_DISCARDABLE_SIZE=43
CONFIG_BT_BUF_EVT_RX_COUNT=2

CONFIG_BT_CONN_TX_MAX=2
CONFIG_BT_L2CAP_TX_BUF_COUNT=2
CONFIG_BT_ATT_TX_COUNT=2
CONFIG_BT_BUF_ACL_TX_COUNT=3
CONFIG_BT_BUF_ACL_TX_SIZE=27
```

## src/main.cpp
```c
/* Copyright 2024 teamprof.net@gmail.com
 *
 * Permission is hereby granted, free of charge, to any person obtaining a copy of this
 * software and associated documentation files (the "Software"), to deal in the Software
 * without restriction, including without limitation the rights to use, copy, modify,
 * merge, publish, distribute, sublicense, and/or sell copies of the Software, and to
 * permit persons to whom the Software is furnished to do so, subject to the following
 * conditions:
 *
 * The above copyright notice and this permission notice shall be included in all
 * copies or substantial portions of the Software.
 *
 * THE SOFTWARE IS PROVIDED "AS IS", WITHOUT WARRANTY OF ANY KIND, EXPRESS OR IMPLIED,
 * INCLUDING BUT NOT LIMITED TO THE WARRANTIES OF MERCHANTABILITY, FITNESS FOR A
 * PARTICULAR PURPOSE AND NONINFRINGEMENT. IN NO EVENT SHALL THE AUTHORS OR COPYRIGHT
 * HOLDERS BE LIABLE FOR ANY CLAIM, DAMAGES OR OTHER LIABILITY, WHETHER IN AN ACTION
 * OF CONTRACT, TORT OR OTHERWISE, ARISING FROM, OUT OF OR IN CONNECTION WITH THE
 * SOFTWARE OR THE USE OR OTHER DEALINGS IN THE SOFTWARE.
 */
#include <stdbool.h>
#include <zephyr/types.h>
#include <zephyr/kernel.h>
#include <zephyr/logging/log.h>

#include <dk_buttons_and_leds.h>

#include "./main.h"
#include "./ble_task.h"
#include "./AppEvent.h"
#include "./BleConst.h"
#include "./LedConst.h"
#include "./led_service.h"

#define LOG_LEVEL 4
LOG_MODULE_REGISTER(main, LOG_LEVEL);

#define USER_LED DK_LED1
#define CON_STATUS_LED DK_LED4

#define USER_BUTTON DK_BTN1_MSK

static void onLedChrcWrite(bool led_state)
{
	postMainEvent(EventBleLed, ActionSetLed, 0, led_state);
}

static bool onLedChrcRead(void)
{
	return MainTask::getInstance()->getLedState();
}

static struct led_service_cb led_callbacks = {
	.write = onLedChrcWrite,
	.read = onLedChrcRead,
};

static void button_changed(uint32_t button_state, uint32_t has_changed)
{
	LOG_DBG("button_state=%u, has_changed=%u", button_state, has_changed);
	if (!button_state && has_changed & USER_BUTTON)
	{
		MainTask::getInstance()->postEvent(EventUserInput, ActionToggleLed);
	}
}

///////////////////////////////////////////////////////////////////////
#define TASK_QUEUE_SIZE 32 // message queue size for app task
K_MSGQ_DEFINE(taskQueue, sizeof(Message), TASK_QUEUE_SIZE, alignof(uint32_t));

MainTask *MainTask::_instance = NULL;

///////////////////////////////////////////////////////////////////////
MainTask::MainTask() : MessageBus(&taskQueue), _ledState(false)
{
	handlerMap = {
		__EVENT_MAP(MainTask, EventUserInput),
		__EVENT_MAP(MainTask, EventBleConnection),
		__EVENT_MAP(MainTask, EventBleLed),
		__EVENT_MAP(MainTask, EventNull), // {EventNull, &MainTask::handlerEventNull},
	};
}

MainTask *MainTask::getInstance(void)
{
	if (!_instance)
	{
		static MainTask mainTask;
		_instance = &mainTask;
	}
	return _instance;
}

void MainTask::start(void *ctx)
{
	MessageBus::start(ctx);

	dk_set_led(USER_LED, _ledState);
	dk_set_led_off(CON_STATUS_LED);
}

void MainTask::onMessage(const Message &msg)
{
	auto func = handlerMap[msg.event];
	if (func)
	{
		(this->*func)(msg);
	}
	else
	{
		LOG_DBG("Unsupported event=%hd, iParam=%hd, uParam=%hu, lParam=%u", msg.event, msg.iParam, msg.uParam, msg.lParam);
	}
}

///////////////////////////////////////////////////////////////////////
bool MainTask::getLedState(void)
{
	return _ledState;
}
void MainTask::setLedState(bool ledState)
{
	_ledState = ledState;
	dk_set_led(USER_LED, ledState);
	ble_led_notify(ledState);
}

void MainTask::toggleLedState(void)
{
	setLedState(!_ledState);
}

///////////////////////////////////////////////////////////////////////
__EVENT_FUNC_DEFINITION(MainTask, EventUserInput, msg) // void MainTask::handlerEventUserInput(const Message &msg)
{
	LOG_DBG("EventUserInput(%hd), iParam=%hd, uParam=%hu, lParam=%u", msg.event, msg.iParam, msg.uParam, msg.lParam);
	auto userAction = msg.iParam;
	switch (userAction)
	{
	case ActionToggleLed:
		toggleLedState();
		break;
	default:
		LOG_DBG("Unsupported userAction=%hd", userAction);
		break;
	}
}
__EVENT_FUNC_DEFINITION(MainTask, EventBleConnection, msg) // void MainTask::handlerEventBleConnection(const Message &msg)
{
	LOG_DBG("EventBleConnection(%hd), iParam=%hd, uParam=%hu, lParam=%u", msg.event, msg.iParam, msg.uParam, msg.lParam);
	auto state = msg.iParam;
	switch (state)
	{
	case BleDisconnected:
		dk_set_led_off(CON_STATUS_LED);
		break;

	case BleConnected:
		dk_set_led_on(CON_STATUS_LED);
		break;

	default:
		LOG_DBG("unsupported state=%hd", state);
		break;
	}
}
__EVENT_FUNC_DEFINITION(MainTask, EventBleLed, msg) // void MainTask::handlerEventBleLed(const Message &msg)
{
	LOG_DBG("EventBleLed(%hd), iParam=%hd, uParam=%hu, lParam=%u", msg.event, msg.iParam, msg.uParam, msg.lParam);
	auto action = msg.iParam;
	bool state = (bool)(msg.lParam);
	switch (action)
	{
	case ActionSetLed:
		setLedState(state);
		break;
	default:
		LOG_DBG("unsupported action=%hd, state=%u", action, state);
		break;
	}
}
__EVENT_FUNC_DEFINITION(MainTask, EventNull, msg) // void MainTask::handlerEventNull(const Message &msg)
{
	LOG_DBG("EventNull(%hd), iParam=%hd, uParam=%hu, lParam=%u", msg.event, msg.iParam, msg.uParam, msg.lParam);
}

///////////////////////////////////////////////////////////////////////
void postMainEvent(int16_t event, int16_t iParam, uint16_t uParam, uint32_t lParam)
{
	LOG_DBG("event=%hd, iParam=%hd, uParam=%hu, lParam=%u", event, iParam, uParam, lParam);
	MainTask::getInstance()->postEvent(event, iParam, uParam, lParam);
}

///////////////////////////////////////////////////////////////////////////////
int main(void)
{
	int err = dk_leds_init();
	if (err)
	{
		LOG_ERR("dk_leds_init() returns %d", err);
		return -1;
	}

	err = dk_buttons_init(button_changed);
	if (err)
	{
		LOG_WRN("dk_buttons_init() returns %d", err);
	}

	bool bleInit = ble_init(&led_callbacks);
	LOG_DBG("ble_init() returns %d", bleInit);

	auto mainTask = MainTask::getInstance();
	mainTask->start(nullptr);
	// mainTask->postEvent(EventNull);
	mainTask->messageLoopForever();

	return 0;
}
```

## src/AppEvent.h
```c
/* Copyright 2024 teamprof.net@gmail.com
 *
 * Permission is hereby granted, free of charge, to any person obtaining a copy of this
 * software and associated documentation files (the "Software"), to deal in the Software
 * without restriction, including without limitation the rights to use, copy, modify,
 * merge, publish, distribute, sublicense, and/or sell copies of the Software, and to
 * permit persons to whom the Software is furnished to do so, subject to the following
 * conditions:
 *
 * The above copyright notice and this permission notice shall be included in all
 * copies or substantial portions of the Software.
 *
 * THE SOFTWARE IS PROVIDED "AS IS", WITHOUT WARRANTY OF ANY KIND, EXPRESS OR IMPLIED,
 * INCLUDING BUT NOT LIMITED TO THE WARRANTIES OF MERCHANTABILITY, FITNESS FOR A
 * PARTICULAR PURPOSE AND NONINFRINGEMENT. IN NO EVENT SHALL THE AUTHORS OR COPYRIGHT
 * HOLDERS BE LIABLE FOR ANY CLAIM, DAMAGES OR OTHER LIABILITY, WHETHER IN AN ACTION
 * OF CONTRACT, TORT OR OTHERWISE, ARISING FROM, OUT OF OR IN CONNECTION WITH THE
 * SOFTWARE OR THE USE OR OTHER DEALINGS IN THE SOFTWARE.
 */
#pragma once
#include <stdint.h>

enum AppEvent
{
    EventNull = 0,

    EventBleConnection = 10, // iParam=<BleConnectionState>
    EventBleLed,             // iParam=<BleEvent>, lParam=<LedState>
    EventUserInput,          // iParam=<UserAction>
};

enum UserAction
{
    ActionNull = 0,
    ActionToggleLed,
    ActionSetLed,
};
```

## src/BleConst.h
```c
/* Copyright 2024 teamprof.net@gmail.com
 *
 * Permission is hereby granted, free of charge, to any person obtaining a copy of this
 * software and associated documentation files (the "Software"), to deal in the Software
 * without restriction, including without limitation the rights to use, copy, modify,
 * merge, publish, distribute, sublicense, and/or sell copies of the Software, and to
 * permit persons to whom the Software is furnished to do so, subject to the following
 * conditions:
 *
 * The above copyright notice and this permission notice shall be included in all
 * copies or substantial portions of the Software.
 *
 * THE SOFTWARE IS PROVIDED "AS IS", WITHOUT WARRANTY OF ANY KIND, EXPRESS OR IMPLIED,
 * INCLUDING BUT NOT LIMITED TO THE WARRANTIES OF MERCHANTABILITY, FITNESS FOR A
 * PARTICULAR PURPOSE AND NONINFRINGEMENT. IN NO EVENT SHALL THE AUTHORS OR COPYRIGHT
 * HOLDERS BE LIABLE FOR ANY CLAIM, DAMAGES OR OTHER LIABILITY, WHETHER IN AN ACTION
 * OF CONTRACT, TORT OR OTHERWISE, ARISING FROM, OUT OF OR IN CONNECTION WITH THE
 * SOFTWARE OR THE USE OR OTHER DEALINGS IN THE SOFTWARE.
 */
#pragma once
#include <stdint.h>

// LED Service UUID.
#define BT_UUID_LED_SERV_VAL \
    BT_UUID_128_ENCODE(0x00001523, 0x1212, 0xefde, 0x1523, 0x785feabcd123)

// LED Characteristic UUID.
#define BT_UUID_LED_CHRC_VAL \
    BT_UUID_128_ENCODE(0x00001525, 0x1212, 0xefde, 0x1523, 0x785feabcd123)

#define BT_UUID_LED_SERV BT_UUID_DECLARE_128(BT_UUID_LED_SERV_VAL)
#define BT_UUID_LED_CHRC BT_UUID_DECLARE_128(BT_UUID_LED_CHRC_VAL)

enum BleEvent
{
    BleEventUnknown = 0,
    BleTx,
    BleRx,
};

enum BleConnectionState
{
    BleConnectionUnknown = 0,
    BleDisconnected,
    BleConnected,
};
```

## src/LedConst.h
```c
/* Copyright 2024 teamprof.net@gmail.com
 *
 * Permission is hereby granted, free of charge, to any person obtaining a copy of this
 * software and associated documentation files (the "Software"), to deal in the Software
 * without restriction, including without limitation the rights to use, copy, modify,
 * merge, publish, distribute, sublicense, and/or sell copies of the Software, and to
 * permit persons to whom the Software is furnished to do so, subject to the following
 * conditions:
 *
 * The above copyright notice and this permission notice shall be included in all
 * copies or substantial portions of the Software.
 *
 * THE SOFTWARE IS PROVIDED "AS IS", WITHOUT WARRANTY OF ANY KIND, EXPRESS OR IMPLIED,
 * INCLUDING BUT NOT LIMITED TO THE WARRANTIES OF MERCHANTABILITY, FITNESS FOR A
 * PARTICULAR PURPOSE AND NONINFRINGEMENT. IN NO EVENT SHALL THE AUTHORS OR COPYRIGHT
 * HOLDERS BE LIABLE FOR ANY CLAIM, DAMAGES OR OTHER LIABILITY, WHETHER IN AN ACTION
 * OF CONTRACT, TORT OR OTHERWISE, ARISING FROM, OUT OF OR IN CONNECTION WITH THE
 * SOFTWARE OR THE USE OR OTHER DEALINGS IN THE SOFTWARE.
 */
#pragma once
#include <stdbool.h>
#include <stdint.h>

enum LedState
{
    LedOff = false,
    LedOn = true,
};
```

## src/ble_task.c
```c
/* Copyright 2024 teamprof.net@gmail.com
 *
 * Permission is hereby granted, free of charge, to any person obtaining a copy of this
 * software and associated documentation files (the "Software"), to deal in the Software
 * without restriction, including without limitation the rights to use, copy, modify,
 * merge, publish, distribute, sublicense, and/or sell copies of the Software, and to
 * permit persons to whom the Software is furnished to do so, subject to the following
 * conditions:
 *
 * The above copyright notice and this permission notice shall be included in all
 * copies or substantial portions of the Software.
 *
 * THE SOFTWARE IS PROVIDED "AS IS", WITHOUT WARRANTY OF ANY KIND, EXPRESS OR IMPLIED,
 * INCLUDING BUT NOT LIMITED TO THE WARRANTIES OF MERCHANTABILITY, FITNESS FOR A
 * PARTICULAR PURPOSE AND NONINFRINGEMENT. IN NO EVENT SHALL THE AUTHORS OR COPYRIGHT
 * HOLDERS BE LIABLE FOR ANY CLAIM, DAMAGES OR OTHER LIABILITY, WHETHER IN AN ACTION
 * OF CONTRACT, TORT OR OTHERWISE, ARISING FROM, OUT OF OR IN CONNECTION WITH THE
 * SOFTWARE OR THE USE OR OTHER DEALINGS IN THE SOFTWARE.
 */
#include <stddef.h>
#include <string.h>
#include <errno.h>
#include <soc.h>

#include <zephyr/types.h>
#include <zephyr/kernel.h>
#include <zephyr/sys/printk.h>
#include <zephyr/sys/byteorder.h>
#include <zephyr/logging/log.h>
#include <zephyr/drivers/gpio.h>
#include <zephyr/settings/settings.h>

#include <zephyr/bluetooth/bluetooth.h>
#include <zephyr/bluetooth/hci.h>
#include <zephyr/bluetooth/conn.h>
#include <zephyr/bluetooth/uuid.h>
#include <zephyr/bluetooth/gatt.h>

#include <dk_buttons_and_leds.h>

#include "./main.h"
#include "./AppEvent.h"
#include "./BleConst.h"
#include "./LedConst.h"
#include "./led_service.h"

#define LOG_LEVEL 4
LOG_MODULE_REGISTER(ble_task, LOG_LEVEL);

#define DEVICE_NAME CONFIG_BT_DEVICE_NAME
#define DEVICE_NAME_LEN (sizeof(DEVICE_NAME) - 1)

static const struct bt_data ad[] = {
    BT_DATA_BYTES(BT_DATA_FLAGS, (BT_LE_AD_GENERAL | BT_LE_AD_NO_BREDR)),
    BT_DATA(BT_DATA_NAME_COMPLETE, DEVICE_NAME, DEVICE_NAME_LEN),
};

static const struct bt_data sd[] = {
    BT_DATA_BYTES(BT_DATA_UUID128_ALL, BT_UUID_LED_SERV_VAL),
};

static void onConnected(struct bt_conn *conn, uint8_t err)
{
    if (err)
    {
        LOG_DBG("Connection failed (err %u)", err);
        return;
    }
    LOG_DBG("Connected");
    postMainEvent(EventBleConnection, BleConnected, 0, 0);
}

static void onDisconnected(struct bt_conn *conn, uint8_t reason)
{
    LOG_DBG("Disconnected: reason=0x%04x", reason);
    postMainEvent(EventBleConnection, BleDisconnected, 0, 0);
}

#ifdef CONFIG_BT_LBS_SECURITY_ENABLED
static void onSecurityChanged(struct bt_conn *conn, bt_security_t level, enum bt_security_err err)
{
    char addr[BT_ADDR_LE_STR_LEN];
    bt_addr_le_to_str(bt_conn_get_dst(conn), addr, sizeof(addr));
    if (!err)
    {
        LOG_DBG("Security changed: %s level %u", addr, level);
    }
    else
    {
        LOG_DBG("Security failed: %s level %u err %d", addr, level, err);
    }
}
#endif

BT_CONN_CB_DEFINE(conn_callbacks) = {
    .connected = onConnected,
    .disconnected = onDisconnected,
#ifdef CONFIG_BT_LBS_SECURITY_ENABLED
    .security_changed = onSecurityChanged,
#endif
};

#if defined(CONFIG_BT_LBS_SECURITY_ENABLED)
static void onAuthPasskeyDisplay(struct bt_conn *conn, unsigned int passkey)
{
    char addr[BT_ADDR_LE_STR_LEN];
    bt_addr_le_to_str(bt_conn_get_dst(conn), addr, sizeof(addr));
    LOG_DBG("Passkey for %s: %06u", addr, passkey);
}

static void onAuthCancel(struct bt_conn *conn)
{
    char addr[BT_ADDR_LE_STR_LEN];
    bt_addr_le_to_str(bt_conn_get_dst(conn), addr, sizeof(addr));
    LOG_DBG("Pairing cancelled: %s", addr);
}

static void onPairingComplete(struct bt_conn *conn, bool bonded)
{
    char addr[BT_ADDR_LE_STR_LEN];
    bt_addr_le_to_str(bt_conn_get_dst(conn), addr, sizeof(addr));
    LOG_DBG("Pairing completed: %s, bonded: %d", addr, bonded);
}

static void onPairingFailed(struct bt_conn *conn, enum bt_security_err reason)
{
    char addr[BT_ADDR_LE_STR_LEN];
    bt_addr_le_to_str(bt_conn_get_dst(conn), addr, sizeof(addr));
    LOG_DBG("Pairing failed conn: %s, reason %d", addr, reason);
}

static struct bt_conn_auth_cb conn_auth_callbacks = {
    .passkey_display = onAuthPasskeyDisplay,
    .cancel = onAuthCancel,
};

static struct bt_conn_auth_info_cb conn_auth_info_callbacks = {
    .pairing_complete = onPairingComplete,
    .pairing_failed = onPairingFailed};
#else
static struct bt_conn_auth_cb conn_auth_callbacks;
static struct bt_conn_auth_info_cb conn_auth_info_callbacks;
#endif

bool ble_init(struct led_service_cb *cb)
{
    int err;

    LOG_DBG("ble_init() ...");

    if (IS_ENABLED(CONFIG_BT_LBS_SECURITY_ENABLED))
    {
        err = bt_conn_auth_cb_register(&conn_auth_callbacks);
        if (err)
        {
            LOG_ERR("Failed to register authorization callbacks: err=%d", err);
            return false;
        }

        err = bt_conn_auth_info_cb_register(&conn_auth_info_callbacks);
        if (err)
        {
            LOG_ERR("Failed to register authorization info callbacks: err=%d", err);
            return false;
        }
    }

    err = bt_enable(NULL);
    if (err)
    {
        LOG_ERR("Bluetooth init failed: err=%d", err);
        return false;
    }

    LOG_DBG("Bluetooth initialized");

    if (IS_ENABLED(CONFIG_SETTINGS))
    {
        settings_load();
    }

    err = ble_led_service_init(cb);
    if (err)
    {
        LOG_ERR("Failed to init LBS: err=%d", err);
        return false;
    }

    err = bt_le_adv_start(BT_LE_ADV_CONN, ad, ARRAY_SIZE(ad), sd, ARRAY_SIZE(sd));
    if (err)
    {
        LOG_ERR("Advertising failed to start: err=%d", err);
        return false;
    }

    LOG_DBG("Advertising successfully started");
    return true;
}
```

## src/ble_task.h
```c
/* Copyright 2024 teamprof.net@gmail.com
 *
 * Permission is hereby granted, free of charge, to any person obtaining a copy of this
 * software and associated documentation files (the "Software"), to deal in the Software
 * without restriction, including without limitation the rights to use, copy, modify,
 * merge, publish, distribute, sublicense, and/or sell copies of the Software, and to
 * permit persons to whom the Software is furnished to do so, subject to the following
 * conditions:
 *
 * The above copyright notice and this permission notice shall be included in all
 * copies or substantial portions of the Software.
 *
 * THE SOFTWARE IS PROVIDED "AS IS", WITHOUT WARRANTY OF ANY KIND, EXPRESS OR IMPLIED,
 * INCLUDING BUT NOT LIMITED TO THE WARRANTIES OF MERCHANTABILITY, FITNESS FOR A
 * PARTICULAR PURPOSE AND NONINFRINGEMENT. IN NO EVENT SHALL THE AUTHORS OR COPYRIGHT
 * HOLDERS BE LIABLE FOR ANY CLAIM, DAMAGES OR OTHER LIABILITY, WHETHER IN AN ACTION
 * OF CONTRACT, TORT OR OTHERWISE, ARISING FROM, OUT OF OR IN CONNECTION WITH THE
 * SOFTWARE OR THE USE OR OTHER DEALINGS IN THE SOFTWARE.
 */
#pragma once
#include <stdbool.h>
#include "./led_service.h"

#ifdef __cplusplus
extern "C"
{
#endif

	extern bool ble_init(struct led_service_cb *cb);

#ifdef __cplusplus
}
#endif
```

## src/led_service.c
```c
/* Copyright 2024 teamprof.net@gmail.com
 *
 * Permission is hereby granted, free of charge, to any person obtaining a copy of this
 * software and associated documentation files (the "Software"), to deal in the Software
 * without restriction, including without limitation the rights to use, copy, modify,
 * merge, publish, distribute, sublicense, and/or sell copies of the Software, and to
 * permit persons to whom the Software is furnished to do so, subject to the following
 * conditions:
 *
 * The above copyright notice and this permission notice shall be included in all
 * copies or substantial portions of the Software.
 *
 * THE SOFTWARE IS PROVIDED "AS IS", WITHOUT WARRANTY OF ANY KIND, EXPRESS OR IMPLIED,
 * INCLUDING BUT NOT LIMITED TO THE WARRANTIES OF MERCHANTABILITY, FITNESS FOR A
 * PARTICULAR PURPOSE AND NONINFRINGEMENT. IN NO EVENT SHALL THE AUTHORS OR COPYRIGHT
 * HOLDERS BE LIABLE FOR ANY CLAIM, DAMAGES OR OTHER LIABILITY, WHETHER IN AN ACTION
 * OF CONTRACT, TORT OR OTHERWISE, ARISING FROM, OUT OF OR IN CONNECTION WITH THE
 * SOFTWARE OR THE USE OR OTHER DEALINGS IN THE SOFTWARE.
 */
#include <zephyr/types.h>
#include <zephyr/logging/log.h>
#include <zephyr/bluetooth/bluetooth.h>
#include <zephyr/bluetooth/conn.h>
#include <zephyr/bluetooth/uuid.h>
#include <zephyr/bluetooth/gatt.h>

#include "BleConst.h"
#include "led_service.h"

#define LOG_LEVEL 4
LOG_MODULE_REGISTER(led_service, LOG_LEVEL);

static struct led_service_cb service_cb;
static bool notify_enabled = false;

static bool button_state;

static void onCccChanged(const struct bt_gatt_attr *attr, uint16_t value)
{
    LOG_DBG("attr->handle=%u, value=%u, BT_GATT_CCC_NOTIFY=%u", attr->handle, value, BT_GATT_CCC_NOTIFY);
    notify_enabled = (value == BT_GATT_CCC_NOTIFY);
}

static ssize_t onChrcWrite(struct bt_conn *conn,
                           const struct bt_gatt_attr *attr,
                           const void *buf,
                           uint16_t len, uint16_t offset, uint8_t flags)
{
    LOG_DBG("conn=%p, attr->handle=%u, len=%u offset=%u, flags=0x%04x", (void *)conn, attr->handle, len, offset, flags);

    if (len != 1U)
    {
        LOG_DBG("Write led: Incorrect data length");
        return BT_GATT_ERR(BT_ATT_ERR_INVALID_ATTRIBUTE_LEN);
    }

    if (offset != 0)
    {
        LOG_DBG("Write led: Incorrect data offset");
        return BT_GATT_ERR(BT_ATT_ERR_INVALID_OFFSET);
    }

    if (service_cb.write)
    {
        uint8_t val = *((uint8_t *)buf);

        if (val == 0x00 || val == 0x01)
        {
            service_cb.write(val ? true : false);
        }
        else
        {
            LOG_DBG("Write led: Incorrect value");
            return BT_GATT_ERR(BT_ATT_ERR_VALUE_NOT_ALLOWED);
        }
    }

    return len;
}

static ssize_t onChrcRead(struct bt_conn *conn,
                          const struct bt_gatt_attr *attr,
                          void *buf,
                          uint16_t len,
                          uint16_t offset)
{
    LOG_DBG("conn=%p, attr->handle=%u, len=%u offset=%u", (void *)conn, attr->handle, len, offset);

    if (service_cb.read)
    {
        bool state = service_cb.read();
        return bt_gatt_attr_read(conn, attr, buf, len, offset, &state, sizeof(state));
    }

    return 0;
}

// LED Service Declaration
BT_GATT_SERVICE_DEFINE(ledService,
                       BT_GATT_PRIMARY_SERVICE(BT_UUID_LED_SERV),
                       BT_GATT_CHARACTERISTIC(BT_UUID_LED_CHRC,
                                              BT_GATT_CHRC_READ | BT_GATT_CHRC_WRITE | BT_GATT_CHRC_NOTIFY,
                                              BT_GATT_PERM_READ | BT_GATT_PERM_WRITE,
                                              onChrcRead, onChrcWrite, &button_state),
                       BT_GATT_CCC(onCccChanged,
                                   BT_GATT_PERM_READ | BT_GATT_PERM_WRITE), );

int ble_led_service_init(struct led_service_cb *cb)
{
    if (cb)
    {
        service_cb.write = cb->write;
        service_cb.read = cb->read;
    }
    return 0;
}

int ble_led_notify(bool value)
{
    return notify_enabled ? bt_gatt_notify(NULL, &ledService.attrs[2], &value, sizeof(value)) : -EACCES;
}
```

## src/led_service.h
```c
/* Copyright 2024 teamprof.net@gmail.com
 *
 * Permission is hereby granted, free of charge, to any person obtaining a copy of this
 * software and associated documentation files (the "Software"), to deal in the Software
 * without restriction, including without limitation the rights to use, copy, modify,
 * merge, publish, distribute, sublicense, and/or sell copies of the Software, and to
 * permit persons to whom the Software is furnished to do so, subject to the following
 * conditions:
 *
 * The above copyright notice and this permission notice shall be included in all
 * copies or substantial portions of the Software.
 *
 * THE SOFTWARE IS PROVIDED "AS IS", WITHOUT WARRANTY OF ANY KIND, EXPRESS OR IMPLIED,
 * INCLUDING BUT NOT LIMITED TO THE WARRANTIES OF MERCHANTABILITY, FITNESS FOR A
 * PARTICULAR PURPOSE AND NONINFRINGEMENT. IN NO EVENT SHALL THE AUTHORS OR COPYRIGHT
 * HOLDERS BE LIABLE FOR ANY CLAIM, DAMAGES OR OTHER LIABILITY, WHETHER IN AN ACTION
 * OF CONTRACT, TORT OR OTHERWISE, ARISING FROM, OUT OF OR IN CONNECTION WITH THE
 * SOFTWARE OR THE USE OR OTHER DEALINGS IN THE SOFTWARE.
 */
#pragma once
#include <stdbool.h>

#ifdef __cplusplus
extern "C"
{
#endif

    typedef void (*led_write_t)(const bool led_state);
    typedef bool (*led_read_t)(void);

    struct led_service_cb
    {
        led_write_t write;
        led_read_t read;
    };

    int ble_led_service_init(struct led_service_cb *callbacks);
    int ble_led_notify(bool value);

#ifdef __cplusplus
}
#endif
```

## src/main.h
```c
/* Copyright 2024 teamprof.net@gmail.com
 *
 * Permission is hereby granted, free of charge, to any person obtaining a copy of this
 * software and associated documentation files (the "Software"), to deal in the Software
 * without restriction, including without limitation the rights to use, copy, modify,
 * merge, publish, distribute, sublicense, and/or sell copies of the Software, and to
 * permit persons to whom the Software is furnished to do so, subject to the following
 * conditions:
 *
 * The above copyright notice and this permission notice shall be included in all
 * copies or substantial portions of the Software.
 *
 * THE SOFTWARE IS PROVIDED "AS IS", WITHOUT WARRANTY OF ANY KIND, EXPRESS OR IMPLIED,
 * INCLUDING BUT NOT LIMITED TO THE WARRANTIES OF MERCHANTABILITY, FITNESS FOR A
 * PARTICULAR PURPOSE AND NONINFRINGEMENT. IN NO EVENT SHALL THE AUTHORS OR COPYRIGHT
 * HOLDERS BE LIABLE FOR ANY CLAIM, DAMAGES OR OTHER LIABILITY, WHETHER IN AN ACTION
 * OF CONTRACT, TORT OR OTHERWISE, ARISING FROM, OUT OF OR IN CONNECTION WITH THE
 * SOFTWARE OR THE USE OR OTHER DEALINGS IN THE SOFTWARE.
 */
#pragma once
#include <stdbool.h>
#include <stdint.h>

#ifdef __cplusplus
#include <map>
#include "./lib/arduprof/ArduProf.h"

class MainTask : public MessageBus
{
public:
    static MainTask *getInstance(void);
    virtual void start(void *);
    virtual void onMessage(const Message &msg);
    bool getLedState(void);

protected:
    typedef void (MainTask::*handlerFunc)(const Message &);
    std::map<int16_t, handlerFunc> handlerMap;

private:
    MainTask();
    static MainTask *_instance;

    bool _ledState;
    void setLedState(bool ledState);
    void toggleLedState(void);

    ///////////////////////////////////////////////////////////////////////////
    // event handler
    ///////////////////////////////////////////////////////////////////////////
    __EVENT_FUNC_DECLARATION(EventUserInput)
    __EVENT_FUNC_DECLARATION(EventBleConnection)
    __EVENT_FUNC_DECLARATION(EventBleLed)
    __EVENT_FUNC_DECLARATION(EventNull) // void handlerEventNull(const Message &msg);
};
#endif

#ifdef __cplusplus
extern "C"
{
#endif

    extern void postMainEvent(int16_t event, int16_t iParam, uint16_t uParam, uint32_t lParam);

#ifdef __cplusplus
}
#endif
```
